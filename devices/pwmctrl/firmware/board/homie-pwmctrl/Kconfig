## devices/pwmctrl/firmware/board/homie-pwmctrl/Kconfig
```kconfig
config BOARD
    default "homie-pwmctrl" if BOARD_HOMIE_PWMCTRL

config BOARD_HOMIE_PWMCTRL
    bool
    default y
    select CPU_MODEL_STM32F030CC
    select HAS_PERIPH_PWM
    select HAS_PERIPH_TIMER
    select HAS_PERIPH_UART
```

## devices/switchy/firmware/board/homie-switchy/Kconfig
```kconfig
config BOARD
    default "homie-switchy" if BOARD_HOMIE_SWITCHY

config BOARD_HOMIE_SWITCHY
    bool
    default y
    select CPU_MODEL_STM32F030CC
    select HAS_PERIPH_PWM
    select HAS_PERIPH_TIMER
    select HAS_PERIPH_UART

menuconfig KCONFIG_BOARD_HOMIE_SWITCHY
    bool "Configure homie-switchy board"
    depends on BOARD_HOMIE_SWITCHY

if KCONFIG_BOARD_HOMIE_SWITCHY

config BOARD_HOMIE_SWITCHY_SW0
    bool "Enable SW0"
    default y

config BOARD_HOMIE_SWITCHY_SW1
    bool "Enable SW1"
    default y

config BOARD_HOMIE_SWITCHY_SW2
    bool "Enable SW2"
    default y

config BOARD_HOMIE_SWITCHY_SW3
    bool "Enable SW3"
    default y

config BOARD_HOMIE_SWITCHY_SW4
    bool "Enable SW4"
    default y

config BOARD_HOMIE_SWITCHY_DEBOUNCE
    int "Debounce time in us"
    default 50000

config BOARD_HOMIE_SWITCHY_FREQ
    int "PWM frequency in Hz"
    default 256

endif
```

## firmware/boards/homie-flowr/Kconfig
```kconfig
config BOARD
    default "homie-flowr" if BOARD_HOMIE_FLOWR

config BOARD_HOMIE_FLOWR
    bool
    default y
    select CPU_MODEL_STM32F030CC
    select HAS_PERIPH_TIMER
    select HAS_PERIPH_UART
```

## firmware/boards/homie-relay/Kconfig
```kconfig
config BOARD
    default "homie-relay" if BOARD_HOMIE_RELAY

config BOARD_HOMIE_RELAY
    bool
    default y
    select CPU_MODEL_STM32F030CC
    select HAS_PERIPH_TIMER
    select HAS_PERIPH_UART
```

## firmware/boards/homie-switchy-rgb/Kconfig
```kconfig
config BOARD
    default "homie-switchy" if BOARD_HOMIE_SWITCHY_RGB

config BOARD_HOMIE_SWITCHY_RGB
    bool
    default y
    select CPU_MODEL_STM32F030CC
    select HAS_PERIPH_PWM
    select HAS_PERIPH_TIMER
    select HAS_PERIPH_UART

menuconfig KCONFIG_BOARD_HOMIE_SWITCHY_RGB
    bool "Configure homie-switchy board"
    depends on BOARD_HOMIE_SWITCHY_RGB

if KCONFIG_BOARD_HOMIE_SWITCHY_RGB

config BOARD_HOMIE_SWITCHY_RGB_SW0
    bool "Enable SW0"
    default y

config BOARD_HOMIE_SWITCHY_RGB_SW1
    bool "Enable SW1"
    default y

config BOARD_HOMIE_SWITCHY_RGB_SW2
    bool "Enable SW2"
    default y

config BOARD_HOMIE_SWITCHY_RGB_SW3
    bool "Enable SW3"
    default y

config BOARD_HOMIE_SWITCHY_RGB_SW4
    bool "Enable SW4"
    default y

config BOARD_HOMIE_SWITCHY_RGB_DEBOUNCE
    int "Debounce time in us"
    default 50000

config BOARD_HOMIE_SWITCHY_RGB_FREQ
    int "PWM frequency in Hz"
    default 128

endif
```

## firmware/drivers/dimmable_led/Kconfig
```kconfig
menuconfig KCONFIG_DIMMABLE_LED
    bool "Configure dimmable_led driver"

if KCONFIG_DIMMABLE_LED

config CONFIG_DIMMABLE_LED_STEP_SIZE
    int "Step size"
    default 16

config CONFIG_DIMMABLE_LED_STEP_DURATION
    int "Duration of one step in ms"
    default 40

endif
```

## firmware/drivers/frequency_counter/Kconfig
```kconfig
menuconfig KCONFIG_FREQUENCY_COUNTER
    bool "Configure frequency_counter driver"

if KCONFIG_FREQUENCY_COUNTER

config CONFIG_FREQUENCY_COUNTER_STACK_SIZE
    int "Stack size"
    default 512

config CONFIG_FREQUENCY_COUNTER_PRIO
    int "Thread priority"
    default 1

config CONFIG_FREQUENCY_COUNTER_SLEEP_MSEC
    int "Sleep time in ms between to measurements"
    default 100

config CONFIG_FREQUENCY_COUNTER_POWER_ON_DELAY_MSEC
    int "Sleep time in ms between power on and measurement"
    default 10

config CONFIG_FREQUENCY_COUNTER_MEASURE_TIME_HZ
    int "Measurement time in Hz"
    default 10

config CONFIG_FREQUENCY_COUNTER_HYSTERESIS_HZ
    int "Hysteresis for significant change in Hz"
    default 100

endif
```
